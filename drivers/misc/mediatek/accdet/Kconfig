## drivers/misc/mediatek/accdet/Kconfig
```kconfig
config MTK_ACCDET
	bool "MediaTek ACCDET driver"
	help
	  ACCDET driver is for headset detect and support for MediaTek SOC
	  If you want to use MediaTek ACCDET driver,
	  say Y.
	  If unsure, say N.

config ACCDET_EINT_IRQ
	bool "MediaTek ACCDET PMIC EINT"
	help
	  ACCDET Internal EINT(PMIC) support for MediaTek SOC
	  If you want to use MediaTek ACCDET EINT from PMIC,
	  say Y.
	  If unsure, say N.

config ACCDET_SUPPORT_EINT0
	bool "MediaTek ACCDET PMIC EINT0"
	help
	  ACCDET use Internal EINT0(PMIC) support for MediaTek SOC
	  If you just want to use MediaTek PMIC ACCDET EINT0,
	  say Y.
	  If unsure, say N.
config TYPEC_ANALOG_HEADPHONE_SUPPORT 
	bool "annlog headset type auto delect support"
	---help---
	if select support, please setting CONFIG_TYPEC_ANALOG_HEADPHONE_SUPPORT
	say Y  here.
	If unsure, say N.
```

## drivers/misc/mediatek/flashlight/Kconfig
```kconfig
#
# Flashlight device configuration
#

config MTK_FLASHLIGHT
	tristate "Mediatek flashlight driver"
	help
	  This is flashlight driver for camera.

	  Say Y here if you want a flashlight core to handle flashlight devices.
	  If you have any questions about this, say Y here,
	  only say N if you know exactly what you are doing.

config MTK_V4L2_FLASHLIGHT
	tristate "Mediatek V4L2 flashlight driver"
	help
	  Say Y to enable V4L2 flashlight device
	  This Framework is good for
	  controling flashlight Leds.
	  Say N to disable V4L2 flashlight.

config MTK_FLASHLIGHT_MT6360
	tristate "Mediatek flashlight with driver IC (Mediatek MT6360)"
	depends on MTK_FLASHLIGHT && RT_FLASHLIGHT
	help
	  This is for the flashlight driver IC (Mediatek MT6360).

	  Say Y here if you want a flashlight driver IC MT6360.
	  Select this only if your board has this IC.

	  Say M here if you want to compile this driver as a module.

config MTK_FLASHLIGHT_DEBUG
	bool "Mediatek flashlight debugging messages"
	depends on MTK_FLASHLIGHT
	help
	  Say Y here if you want the flashlight to produce a bunch of debug
	  messages to the system log.

	  Select this if you are having a problem with flashlight support
	  and want to see more of what is going on.

config MTK_FLASHLIGHT_PT
	bool "Mediatek flashlight power throttling"
	depends on MTK_FLASHLIGHT
	help
	  This is for flashlight power throttling.

	  Power throttling will limit flashlight function,
	  such as disable flashlight, decrease brightness level or
	  change flash mode to torch mode.

config MTK_FLASHLIGHT_PT_STRICT
	bool "Mediatek flashlight power throttling (strict)"
	depends on MTK_FLASHLIGHT_PT
	help
	  This is for flashlight strict power throttling.

	  Strict power throttling will disable flashlight when
	  over-current, low battary voltage and low battary percentage
	  situations.

config MTK_FLASHLIGHT_DLPT
	bool "Mediatek flashlight dynamic low power throttling"
	depends on MTK_FLASHLIGHT
	help
	  This is for flashlight dynamic low power throttling.

	  Dynamic low power throttling is a mechanism to monitor
	  the current of battary dynamicly. It will start by request
	  and notice user by kernel notifier.
```

## drivers/nfc/pn553/Kconfig
```kconfig
config NFC_PN553_DEVICES
	bool "NXP PN553/PN557 support"
	help
	  Say Y to enable
	  NXP PN553/PN557 support
	  Say N to disable
	  NXP PN553/PN557 support
```

## drivers/nfc/thn31/Kconfig
```kconfig
config TMS_NFC_DEVICE
	bool "TMS NFC THN31 support"
	help
	  Say Y to enable
	  TMS NFC THN31 support
	  Say N to disable
	  TMS NFC THN31 not support

config TMS_ESE_DEVICE
	bool "TMS NFC THN31 support"
	depends on TMS_NFC_DEVICE
	help
	  Say Y to enable
	  TMS_ESE_DEVICE support
	  Say N to disable
	  TMS_ESE_DEVICE not support

config TMS_GUIDE_DEVICE
	bool "TMS_GUIDE_DEVICE support"
	depends on TMS_NFC_DEVICE
	help
	  Say Y to enable
	  TMS_GUIDE_DEVICE support
	  Say N to disable
	  TMS_GUIDE_DEVICE not support
```
